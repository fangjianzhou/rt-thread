## bsp/rockchip/rk3500/driver/Kconfig
```kconfig
menu "RT-Thread rockchip RK3500 drivers"

source "$BSP_DIR/driver/net/Kconfig"
source "$BSP_DIR/driver/clk/Kconfig"
source "$BSP_DIR/driver/hwtimer/Kconfig"
source "$BSP_DIR/driver/pin/Kconfig"
source "$BSP_DIR/driver/pinctrl/Kconfig"
source "$BSP_DIR/driver/reset/Kconfig"
source "$BSP_DIR/driver/sdhci/Kconfig"
source "$BSP_DIR/driver/mfd/Kconfig"
source "$BSP_DIR/driver/uart8250/Kconfig"

endmenu
```

## bsp/rockchip/rk3500/driver/net/Kconfig
```kconfig
menuconfig RT_USING_NET
    bool "Using net device drivers"
    default y

config RT_USING_DWC_EQOS
    bool "Using builtin fdt in kernel"
    depends on RT_USING_NET
    default y

config RT_USING_DWC_EQOS_ROCKCHIP
    bool "Builtin fdt path, will rebuild if have dts"
    depends on RT_USING_DWC_EQOS
    default y
```

## bsp/rockchip/rk3500/driver/sdhci/Kconfig
```kconfig
config RT_SDIO_SDHCI_DWCMSHC
    bool "Synopsys DWC MSHC SDHCI"
    select RT_USING_OFW
    default n
```

## components/drivers/adc/Kconfig
```kconfig
menuconfig RT_USING_ADC
    bool "Using ADC device drivers"
    default n

config RT_ADC_ROCKCHIP_SARADC
    bool "Rockchip SARADC driver"
    depends on RT_USING_DM
    depends on RT_USING_ADC
    select RT_USING_RESET
    select RT_USING_REGULATOR
    default n
```

## components/drivers/phy/rockchip/Kconfig
```kconfig
config RT_PHY_ROCKCHIP_SNPS_PCIE3
    bool "Rockchip Snps PCIe3 PHY Driver"
    select RT_MFD_SYSCON
    default n
```

## components/drivers/pinctrl/Kconfig
```kconfig
menuconfig RT_USING_PINCTRL
    bool "Using Pin controllers device drivers"
    depends on RT_USING_DM
    depends on RT_USING_PIN
    default n

config RT_PINCTRL_ROCKCHIP
    bool "Rockchip gpio and pinctrl driver"
    depends on RT_USING_PINCTRL
    select RT_MFD_SYSCON
    default n
```

## components/drivers/pwm/Kconfig
```kconfig
menuconfig RT_USING_PWM
    bool "Using PWM device drivers"
    default n

config RT_PWM_ROCKCHIP
    bool "Rockchip PWM support"
    select RT_USING_PINCTRL
    depends on RT_USING_DM
    depends on RT_USING_PWM
    default n
```

## components/drivers/regulator/Kconfig
```kconfig
menuconfig RT_USING_REGULATOR
    bool "Using Voltage and Current Regulator"
    depends on RT_USING_DM
    default n

config RT_REGULATOR_GPIO
    bool "GPIO regulator support"
    depends on RT_USING_REGULATOR
    depends on RT_USING_PIN
    default y

config RT_REGULATOR_RK8XX
    bool "Rockchip RK805/RK808/RK809/RK817/RK818 Power regulators"
    depends on RT_USING_REGULATOR
    depends on RT_MFD_RK8XX
    select RT_USING_PIN
    default y
```

## components/drivers/sensor/Kconfig
```kconfig
menuconfig RT_USING_SENSOR
    bool "Using Sensor device drivers"
    select RT_USING_PIN
    default n

if RT_USING_SENSOR
    config RT_USING_SENSOR_CMD
        bool "Using Sensor cmd"
        select PKG_USING_RT_VSNPRINTF_FULL
        default y
endif

config RT_ADC_ROCKCHIP_TSADC
    bool "Rockchip TSADC(thermal) driver"
    depends on RT_USING_DM
    depends on RT_USING_SENSOR
    select RT_MFD_SYSCON
    select RT_USING_RESET
    default n
```

## components/drivers/soc/rockchip/Kconfig
```kconfig
menuconfig RT_SOC_ROCKCHIP
    bool "RockChip"
    default n

if RT_SOC_ROCKCHIP
config RT_SOC_ROCKCHIP_FIQ_DEBUGGER
    bool "FIQ Debugger"
    select RT_USING_OFW
    default y

config RT_SOC_ROCKCHIP_IODOMAIN
    bool "Rockchip IO domain support"
    select RT_MFD_SYSCON
    select RT_USING_REGULATOR
    default y
endif
```

## components/drivers/watchdog/Kconfig
```kconfig
menuconfig RT_USING_WDT
    bool "Using Watch Dog device drivers"
    default n

config RT_WDT_BCM2835
    bool "Broadcom BCM2835 hardware watchdog"
    depends on RT_USING_DM
    depends on RT_USING_WDT
    default n

config RT_WDT_DW
    bool "Synopsys DesignWare watchdog"
    depends on RT_USING_DM
    depends on RT_USING_WDT
    default n
```

## examples/utest/testcases/lwp/Kconfig
```kconfig
menu "LwP Testcases"

    config UTEST_LWP_TC
    bool "Enable Utest for lwp"
    depends on RT_USING_SMART
    default n

endmenu
```
